/dts-v1/;

/ {
	model = "Qualcomm Technologies, Inc. Bengal RUMI";
	compatible = "qcom,bengal-rumi\0qcom,bengal\0qcom,rumi";
	qcom,msm-id = <0x1a1 0x10000>;
	qcom,board-id = <0x0f 0x00>;

	fragment@0 {
		target = <0xffffffff>;

		__overlay__ {

			usb_emu_phy@4f20000 {
				compatible = "qcom,usb-emu-phy";
				reg = <0x4f20000 0x9500 0x4ef8800 0x100>;
				reg-names = "base\0qscratch_base";
				qcom,emu-init-seq = <0xffff 0x04 0xfff0 0x04 0x100000 0x20 0x00 0x20 0x101f0 0x20 0x100000 0x3c 0x00 0x3c 0x10060 0x3c 0x00 0x04>;
				phandle = <0x08>;
			};

			timer {
				clock-frequency = <0x7a120>;
			};

			timer@f120000 {
				clock-frequency = <0x7a120>;
			};

			qcom,wdt@f017000 {
				status = "disabled";
				phandle = <0x09>;
			};

			bi_tcxo {
				compatible = "fixed-factor-clock";
				clocks = <0xffffffff>;
				clock-mult = <0x01>;
				clock-div = <0x01>;
				#clock-cells = <0x00>;
				phandle = <0x0a>;
			};

			bi_tcxo_ao {
				compatible = "fixed-factor-clock";
				clocks = <0xffffffff>;
				clock-mult = <0x01>;
				clock-div = <0x01>;
				#clock-cells = <0x00>;
				phandle = <0x0b>;
			};

			qmi-tmd-devices {
				status = "disabled";
			};
		};
	};

	fragment@1 {
		target = <0xffffffff>;

		__overlay__ {
			status = "disabled";
		};
	};

	fragment@2 {
		target = <0xffffffff>;

		__overlay__ {
			rpm-standalone;
		};
	};

	fragment@3 {
		target = <0xffffffff>;

		__overlay__ {
			status = "disabled";
		};
	};

	fragment@4 {
		target = <0xffffffff>;

		__overlay__ {
			status = "disabled";
		};
	};

	fragment@5 {
		target = <0xffffffff>;

		__overlay__ {
			status = "disabled";
		};
	};

	fragment@6 {
		target = <0xffffffff>;

		__overlay__ {
			status = "disabled";
		};
	};

	fragment@7 {
		target = <0xffffffff>;

		__overlay__ {
			status = "disabled";
		};
	};

	fragment@8 {
		target = <0xffffffff>;

		__overlay__ {
			status = "disabled";
		};
	};

	fragment@9 {
		target = <0xffffffff>;

		__overlay__ {
			status = "disabled";
		};
	};

	fragment@10 {
		target = <0xffffffff>;

		__overlay__ {
		};
	};

	fragment@11 {
		target = <0xffffffff>;

		__overlay__ {

			regulator-pm6125-s1 {
				compatible = "qcom,stub-regulator";
				regulator-name = "pm6125_s1";
				qcom,hpm-min-load = <0x2710>;
				regulator-min-microvolt = <0x71868>;
				regulator-max-microvolt = <0x119fb8>;
				phandle = <0x0c>;
			};

			regulator-pm6125-s3-level {
				compatible = "qcom,stub-regulator";
				regulator-name = "pm6125_s3_level";
				qcom,hpm-min-load = <0x2710>;
				regulator-min-microvolt = <0x10>;
				regulator-max-microvolt = <0xffff>;
				phandle = <0x0d>;
			};

			regulator-pm6125-s3-level-ao {
				compatible = "qcom,stub-regulator";
				regulator-name = "pm6125_s3_level_ao";
				qcom,hpm-min-load = <0x2710>;
				regulator-min-microvolt = <0x10>;
				regulator-max-microvolt = <0xffff>;
				phandle = <0x0e>;
			};

			regulator-pm6125-s5-level {
				compatible = "qcom,stub-regulator";
				regulator-name = "pm6125_s5_level";
				qcom,hpm-min-load = <0x2710>;
				regulator-min-microvolt = <0x10>;
				regulator-max-microvolt = <0xffff>;
				phandle = <0x0f>;
			};

			regulator-pm6125-s5-level-ao {
				compatible = "qcom,stub-regulator";
				regulator-name = "pm6125_s5_level_ao";
				qcom,hpm-min-load = <0x2710>;
				regulator-min-microvolt = <0x10>;
				regulator-max-microvolt = <0xffff>;
				phandle = <0x10>;
			};

			regulator-pm6125-s6 {
				compatible = "qcom,stub-regulator";
				regulator-name = "pm6125_s6";
				qcom,hpm-min-load = <0x2710>;
				regulator-min-microvolt = <0x493e0>;
				regulator-max-microvolt = <0x162010>;
				phandle = <0x11>;
			};

			regulator-pm6125-s7 {
				compatible = "qcom,stub-regulator";
				regulator-name = "pm6125_s7";
				qcom,hpm-min-load = <0x2710>;
				regulator-min-microvolt = <0x1360f0>;
				regulator-max-microvolt = <0x336c0f>;
				phandle = <0x12>;
			};

			regulator-pm6125-s8 {
				compatible = "qcom,stub-regulator";
				regulator-name = "pm6125_s8";
				qcom,hpm-min-load = <0x2710>;
				regulator-min-microvolt = <0x102ca0>;
				regulator-max-microvolt = <0x13d620>;
				phandle = <0x13>;
			};

			regulator-pm6125-l1 {
				compatible = "qcom,stub-regulator";
				regulator-name = "pm6125_l1";
				qcom,hpm-min-load = <0x2710>;
				regulator-min-microvolt = <0xe7ef0>;
				regulator-max-microvolt = <0x118c30>;
				phandle = <0x14>;
			};

			regulator-pm6125-l2-level {
				compatible = "qcom,stub-regulator";
				regulator-name = "pm6125_l2_level";
				qcom,hpm-min-load = <0x2710>;
				regulator-min-microvolt = <0x10>;
				regulator-max-microvolt = <0xffff>;
				phandle = <0x15>;
			};

			regulator-pm6125-l3-level {
				compatible = "qcom,stub-regulator";
				regulator-name = "pm6125_l3_level";
				qcom,hpm-min-load = <0x2710>;
				regulator-min-microvolt = <0x10>;
				regulator-max-microvolt = <0xffff>;
				phandle = <0x16>;
			};

			regulator-pm6125-l4 {
				compatible = "qcom,stub-regulator";
				regulator-name = "pm6125_l4";
				qcom,hpm-min-load = <0x2710>;
				regulator-min-microvolt = <0x77240>;
				regulator-max-microvolt = <0xf4240>;
				phandle = <0x05>;
			};

			regulator-pm6125-l5 {
				compatible = "qcom,stub-regulator";
				regulator-name = "pm6125_l5";
				qcom,hpm-min-load = <0x2710>;
				regulator-min-microvolt = <0x192d50>;
				regulator-max-microvolt = <0x2e8a10>;
				phandle = <0x04>;
			};

			regulator-pm6125-l6 {
				compatible = "qcom,stub-regulator";
				regulator-name = "pm6125_l6";
				qcom,hpm-min-load = <0x2710>;
				regulator-min-microvolt = <0x8b290>;
				regulator-max-microvolt = <0x9eb10>;
				phandle = <0x17>;
			};

			regulator-pm6125-l7 {
				compatible = "qcom,stub-regulator";
				regulator-name = "pm6125_l7";
				qcom,hpm-min-load = <0x2710>;
				regulator-min-microvolt = <0x124f80>;
				regulator-max-microvolt = <0x13d620>;
				phandle = <0x18>;
			};

			regulator-pm6125-l8 {
				compatible = "qcom,stub-regulator";
				regulator-name = "pm6125_l8";
				qcom,hpm-min-load = <0x2710>;
				regulator-min-microvolt = <0x61a80>;
				regulator-max-microvolt = <0xb1bc0>;
				phandle = <0x19>;
			};

			regulator-pm6125-l9 {
				compatible = "qcom,stub-regulator";
				regulator-name = "pm6125_l9";
				qcom,hpm-min-load = <0x2710>;
				regulator-min-microvolt = <0x1b7740>;
				regulator-max-microvolt = <0x1e8480>;
				phandle = <0x1a>;
			};

			regulator-pm6125-l10 {
				compatible = "qcom,stub-regulator";
				regulator-name = "pm6125_l10";
				qcom,hpm-min-load = <0x2710>;
				regulator-min-microvolt = <0x19f0a0>;
				regulator-max-microvolt = <0x1cfde0>;
				phandle = <0x1b>;
			};

			regulator-pm6125-l11 {
				compatible = "qcom,stub-regulator";
				regulator-name = "pm6125_l11";
				qcom,hpm-min-load = <0x2710>;
				regulator-min-microvolt = <0x19f0a0>;
				regulator-max-microvolt = <0x1dc130>;
				phandle = <0x02>;
			};

			regulator-pm6125-l12 {
				compatible = "qcom,stub-regulator";
				regulator-name = "pm6125_l12";
				qcom,hpm-min-load = <0x2710>;
				regulator-min-microvolt = <0x18b820>;
				regulator-max-microvolt = <0x1e3660>;
				phandle = <0x06>;
			};

			regulator-pm6125-l13 {
				compatible = "qcom,stub-regulator";
				regulator-name = "pm6125_l13";
				qcom,hpm-min-load = <0x2710>;
				regulator-min-microvolt = <0x16e360>;
				regulator-max-microvolt = <0x2f4d60>;
				phandle = <0x1c>;
			};

			regulator-pm6125-l14 {
				compatible = "qcom,stub-regulator";
				regulator-name = "pm6125_l14";
				qcom,hpm-min-load = <0x2710>;
				regulator-min-microvolt = <0x19f0a0>;
				regulator-max-microvolt = <0x1cfde0>;
				phandle = <0x1d>;
			};

			regulator-pm6125-l15 {
				compatible = "qcom,stub-regulator";
				regulator-name = "pm6125_l15";
				qcom,hpm-min-load = <0x2710>;
				regulator-min-microvolt = <0x231860>;
				regulator-max-microvolt = <0x36ee80>;
				phandle = <0x1e>;
			};

			regulator-pm6125-l16 {
				compatible = "qcom,stub-regulator";
				regulator-name = "pm6125_l16";
				qcom,hpm-min-load = <0x2710>;
				regulator-min-microvolt = <0x19f0a0>;
				regulator-max-microvolt = <0x1cfde0>;
				phandle = <0x1f>;
			};

			regulator-pm6125-l17 {
				compatible = "qcom,stub-regulator";
				regulator-name = "pm6125_l17";
				qcom,hpm-min-load = <0x2710>;
				regulator-min-microvolt = <0x118c30>;
				regulator-max-microvolt = <0x150ea0>;
				phandle = <0x20>;
			};

			regulator-pm6125-l18 {
				compatible = "qcom,stub-regulator";
				regulator-name = "pm6125_l18";
				qcom,hpm-min-load = <0x2710>;
				regulator-min-microvolt = <0x10c8e0>;
				regulator-max-microvolt = <0x1406f4>;
				phandle = <0x07>;
			};

			regulator-pm6125-l19 {
				compatible = "qcom,stub-regulator";
				regulator-name = "pm6125_l19";
				qcom,hpm-min-load = <0x2710>;
				regulator-min-microvolt = <0x18b820>;
				regulator-max-microvolt = <0x325aa0>;
				phandle = <0x21>;
			};

			regulator-pm6125-l20 {
				compatible = "qcom,stub-regulator";
				regulator-name = "pm6125_l20";
				qcom,hpm-min-load = <0x2710>;
				regulator-min-microvolt = <0x18b820>;
				regulator-max-microvolt = <0x325aa0>;
				phandle = <0x22>;
			};

			regulator-pm6125-l21 {
				compatible = "qcom,stub-regulator";
				regulator-name = "pm6125_l21";
				qcom,hpm-min-load = <0x2710>;
				regulator-min-microvolt = <0x249f00>;
				regulator-max-microvolt = <0x36ee80>;
				phandle = <0x23>;
			};

			regulator-pm6125-l22 {
				compatible = "qcom,stub-regulator";
				regulator-name = "pm6125_l22";
				qcom,hpm-min-load = <0x2710>;
				regulator-min-microvolt = <0x2d0370>;
				regulator-max-microvolt = <0x325aa0>;
				phandle = <0x03>;
			};

			regulator-pm6125-l23 {
				compatible = "qcom,stub-regulator";
				regulator-name = "pm6125_l23";
				qcom,hpm-min-load = <0x2710>;
				regulator-min-microvolt = <0x30d400>;
				regulator-max-microvolt = <0x33e140>;
				phandle = <0x24>;
			};

			regulator-pm6125-l24 {
				compatible = "qcom,stub-regulator";
				regulator-name = "pm6125_l24";
				qcom,hpm-min-load = <0x2710>;
				regulator-min-microvolt = <0x2932e0>;
				regulator-max-microvolt = <0x36ee80>;
				phandle = <0x01>;
			};
		};
	};

	fragment@12 {
		target = <0xffffffff>;

		__overlay__ {
			vdd-supply = <0x01>;
			qcom,vdd-voltage-level = <0x2d2a80 0x2d2a80>;
			qcom,vdd-current-level = <0x00 0x8b290>;
			vdd-io-supply = <0x02>;
			qcom,vdd-io-always-on;
			qcom,vdd-io-lpm-sup;
			qcom,vdd-io-voltage-level = <0x1b7740 0x1b7740>;
			qcom,vdd-io-current-level = <0x00 0x4f588>;
			pinctrl-names = "active\0sleep";
			pinctrl-0 = <0xffffffff 0xffffffff 0xffffffff 0xffffffff>;
			pinctrl-1 = <0xffffffff 0xffffffff 0xffffffff 0xffffffff>;
			qcom,clk-rates = <0x61a80 0x1312d00 0x17d7840 0x2faf080>;
			qcom,bus-speed-mode = "DDR_1p8v";
			status = "ok";
		};
	};

	fragment@13 {
		target = <0xffffffff>;

		__overlay__ {
			vdd-supply = <0x03>;
			qcom,vdd-voltage-level = <0x2d2a80 0x2d2a80>;
			qcom,vdd-current-level = <0x00 0xc3500>;
			vdd-io-supply = <0x04>;
			qcom,vdd-io-voltage-level = <0x1b7740 0x2d0370>;
			qcom,vdd-io-current-level = <0x00 0x55f0>;
			pinctrl-names = "active\0sleep";
			pinctrl-0 = <0xffffffff 0xffffffff 0xffffffff>;
			pinctrl-1 = <0xffffffff 0xffffffff 0xffffffff>;
			qcom,clk-rates = <0x61a80 0x1312d00 0x17d7840 0x2faf080>;
			qcom,bus-speed-mode = "SDR12\0SDR25\0SDR50";
			status = "ok";
		};
	};

	fragment@14 {
		target = <0xffffffff>;

		__overlay__ {
			compatible = "qcom,ufs-phy-qrbtc-sdm845";
			vdda-phy-supply = <0x05>;
			vdda-pll-supply = <0x06>;
			vdda-phy-max-microamp = <0xc8c8>;
			vdda-pll-max-microamp = <0x3778>;
			status = "ok";
		};
	};

	fragment@15 {
		target = <0xffffffff>;

		__overlay__ {
			limit-tx-hs-gear = <0x01>;
			limit-rx-hs-gear = <0x01>;
			scsi-cmd-timeout = <0x493e0>;
			vdd-hba-supply = <0xffffffff>;
			vdd-hba-fixed-regulator;
			vcc-supply = <0x01>;
			vccq2-supply = <0x02>;
			vcc-max-microamp = <0x927c0>;
			vccq2-max-microamp = <0x927c0>;
			qcom,vddp-ref-clk-supply = <0x07>;
			qcom,vddp-ref-clk-max-microamp = <0x64>;
			qcom,vddp-ref-clk-min-uV = <0x12cc80>;
			qcom,vddp-ref-clk-max-uV = <0x12cc80>;
			qcom,disable-lpm;
			status = "ok";
		};
	};

	fragment@16 {
		target = <0xffffffff>;

		__overlay__ {
			dpdm-supply = <0xffffffff>;

			dwc3@4e00000 {
				usb-phy = <0x08 0xffffffff>;
				maximum-speed = "high-speed";
				dr_mode = "peripheral";
			};
		};
	};

	fragment@17 {
		target = <0xffffffff>;

		__overlay__ {
			compatible = "qcom,dummycc";
			clock-output-names = "rpmcc_clocks";
			#clock-cells = <0x01>;
			#reset-cells = <0x01>;
		};
	};

	fragment@18 {
		target = <0xffffffff>;

		__overlay__ {
			compatible = "qcom,dummycc";
			clock-output-names = "debugcc_clocks";
		};
	};

	__symbols__ {
		usb_emu_phy = "/fragment@0/__overlay__/usb_emu_phy@4f20000";
		wdog = "/fragment@0/__overlay__/qcom,wdt@f017000";
		bi_tcxo = "/fragment@0/__overlay__/bi_tcxo";
		bi_tcxo_ao = "/fragment@0/__overlay__/bi_tcxo_ao";
		S1A = "/fragment@11/__overlay__/regulator-pm6125-s1";
		pm6125_s1 = "/fragment@11/__overlay__/regulator-pm6125-s1";
		VDD_CX_LEVEL = "/fragment@11/__overlay__/regulator-pm6125-s3-level";
		S3A_LEVEL = "/fragment@11/__overlay__/regulator-pm6125-s3-level";
		pm6125_s3_level = "/fragment@11/__overlay__/regulator-pm6125-s3-level";
		VDD_CX_LEVEL_AO = "/fragment@11/__overlay__/regulator-pm6125-s3-level-ao";
		S3A_LEVEL_AO = "/fragment@11/__overlay__/regulator-pm6125-s3-level-ao";
		pm6125_s3_level_ao = "/fragment@11/__overlay__/regulator-pm6125-s3-level-ao";
		VDD_MX_LEVEL = "/fragment@11/__overlay__/regulator-pm6125-s5-level";
		S5A_LEVEL = "/fragment@11/__overlay__/regulator-pm6125-s5-level";
		pm6125_s5_level = "/fragment@11/__overlay__/regulator-pm6125-s5-level";
		VDD_MX_LEVEL_AO = "/fragment@11/__overlay__/regulator-pm6125-s5-level-ao";
		S5A_LEVEL_AO = "/fragment@11/__overlay__/regulator-pm6125-s5-level-ao";
		pm6125_s5_level_ao = "/fragment@11/__overlay__/regulator-pm6125-s5-level-ao";
		S6A = "/fragment@11/__overlay__/regulator-pm6125-s6";
		pm6125_s6 = "/fragment@11/__overlay__/regulator-pm6125-s6";
		S7A = "/fragment@11/__overlay__/regulator-pm6125-s7";
		pm6125_s7 = "/fragment@11/__overlay__/regulator-pm6125-s7";
		S8A = "/fragment@11/__overlay__/regulator-pm6125-s8";
		pm6125_s8 = "/fragment@11/__overlay__/regulator-pm6125-s8";
		L1A = "/fragment@11/__overlay__/regulator-pm6125-l1";
		pm6125_l1 = "/fragment@11/__overlay__/regulator-pm6125-l1";
		L2A_LEVEL = "/fragment@11/__overlay__/regulator-pm6125-l2-level";
		pm6125_l2_level = "/fragment@11/__overlay__/regulator-pm6125-l2-level";
		L3A_LEVEL = "/fragment@11/__overlay__/regulator-pm6125-l3-level";
		pm6125_l3_level = "/fragment@11/__overlay__/regulator-pm6125-l3-level";
		L4A = "/fragment@11/__overlay__/regulator-pm6125-l4";
		pm6125_l4 = "/fragment@11/__overlay__/regulator-pm6125-l4";
		L5A = "/fragment@11/__overlay__/regulator-pm6125-l5";
		pm6125_l5 = "/fragment@11/__overlay__/regulator-pm6125-l5";
		L6A = "/fragment@11/__overlay__/regulator-pm6125-l6";
		pm6125_l6 = "/fragment@11/__overlay__/regulator-pm6125-l6";
		L7A = "/fragment@11/__overlay__/regulator-pm6125-l7";
		pm6125_l7 = "/fragment@11/__overlay__/regulator-pm6125-l7";
		L8A = "/fragment@11/__overlay__/regulator-pm6125-l8";
		pm6125_l8 = "/fragment@11/__overlay__/regulator-pm6125-l8";
		L9A = "/fragment@11/__overlay__/regulator-pm6125-l9";
		pm6125_l9 = "/fragment@11/__overlay__/regulator-pm6125-l9";
		L10A = "/fragment@11/__overlay__/regulator-pm6125-l10";
		pm6125_l10 = "/fragment@11/__overlay__/regulator-pm6125-l10";
		L11A = "/fragment@11/__overlay__/regulator-pm6125-l11";
		pm6125_l11 = "/fragment@11/__overlay__/regulator-pm6125-l11";
		L12A = "/fragment@11/__overlay__/regulator-pm6125-l12";
		pm6125_l12 = "/fragment@11/__overlay__/regulator-pm6125-l12";
		L13A = "/fragment@11/__overlay__/regulator-pm6125-l13";
		pm6125_l13 = "/fragment@11/__overlay__/regulator-pm6125-l13";
		L14A = "/fragment@11/__overlay__/regulator-pm6125-l14";
		pm6125_l14 = "/fragment@11/__overlay__/regulator-pm6125-l14";
		L15A = "/fragment@11/__overlay__/regulator-pm6125-l15";
		pm6125_l15 = "/fragment@11/__overlay__/regulator-pm6125-l15";
		L16A = "/fragment@11/__overlay__/regulator-pm6125-l16";
		pm6125_l16 = "/fragment@11/__overlay__/regulator-pm6125-l16";
		L17A = "/fragment@11/__overlay__/regulator-pm6125-l17";
		pm6125_l17 = "/fragment@11/__overlay__/regulator-pm6125-l17";
		L18A = "/fragment@11/__overlay__/regulator-pm6125-l18";
		pm6125_l18 = "/fragment@11/__overlay__/regulator-pm6125-l18";
		L19A = "/fragment@11/__overlay__/regulator-pm6125-l19";
		pm6125_l19 = "/fragment@11/__overlay__/regulator-pm6125-l19";
		L20A = "/fragment@11/__overlay__/regulator-pm6125-l20";
		pm6125_l20 = "/fragment@11/__overlay__/regulator-pm6125-l20";
		L21A = "/fragment@11/__overlay__/regulator-pm6125-l21";
		pm6125_l21 = "/fragment@11/__overlay__/regulator-pm6125-l21";
		L22A = "/fragment@11/__overlay__/regulator-pm6125-l22";
		pm6125_l22 = "/fragment@11/__overlay__/regulator-pm6125-l22";
		L23A = "/fragment@11/__overlay__/regulator-pm6125-l23";
		pm6125_l23 = "/fragment@11/__overlay__/regulator-pm6125-l23";
		L24A = "/fragment@11/__overlay__/regulator-pm6125-l24";
		pm6125_l24 = "/fragment@11/__overlay__/regulator-pm6125-l24";
	};

	__fixups__ {
		soc = "/fragment@0:target:0\0/fragment@11:target:0";
		xo_board = "/fragment@0/__overlay__/bi_tcxo:clocks:0\0/fragment@0/__overlay__/bi_tcxo_ao:clocks:0";
		qupv3_se1_i2c = "/fragment@1:target:0";
		rpm_bus = "/fragment@2:target:0";
		tsens0 = "/fragment@3:target:0";
		bcl_sensor = "/fragment@4:target:0";
		bcl_soc = "/fragment@5:target:0";
		lmh_cpu_vdd = "/fragment@6:target:0";
		cxip_cdev = "/fragment@7:target:0";
		lmh_dcvs0 = "/fragment@8:target:0";
		lmh_dcvs1 = "/fragment@9:target:0";
		thermal_zones = "/fragment@10:target:0";
		sdhc_1 = "/fragment@12:target:0";
		sdc1_clk_on = "/fragment@12/__overlay__:pinctrl-0:0";
		sdc1_cmd_on = "/fragment@12/__overlay__:pinctrl-0:4";
		sdc1_data_on = "/fragment@12/__overlay__:pinctrl-0:8";
		sdc1_rclk_on = "/fragment@12/__overlay__:pinctrl-0:12";
		sdc1_clk_off = "/fragment@12/__overlay__:pinctrl-1:0";
		sdc1_cmd_off = "/fragment@12/__overlay__:pinctrl-1:4";
		sdc1_data_off = "/fragment@12/__overlay__:pinctrl-1:8";
		sdc1_rclk_off = "/fragment@12/__overlay__:pinctrl-1:12";
		sdhc_2 = "/fragment@13:target:0";
		sdc2_clk_on = "/fragment@13/__overlay__:pinctrl-0:0";
		sdc2_cmd_on = "/fragment@13/__overlay__:pinctrl-0:4";
		sdc2_data_on = "/fragment@13/__overlay__:pinctrl-0:8";
		sdc2_clk_off = "/fragment@13/__overlay__:pinctrl-1:0";
		sdc2_cmd_off = "/fragment@13/__overlay__:pinctrl-1:4";
		sdc2_data_off = "/fragment@13/__overlay__:pinctrl-1:8";
		ufsphy_mem = "/fragment@14:target:0";
		ufshc_mem = "/fragment@15:target:0";
		gcc_ufs_phy_gdsc = "/fragment@15/__overlay__:vdd-hba-supply:0";
		usb0 = "/fragment@16:target:0";
		usb_nop_phy = "/fragment@16/__overlay__:dpdm-supply:0\0/fragment@16/__overlay__/dwc3@4e00000:usb-phy:4";
		rpmcc = "/fragment@17:target:0";
		debugcc = "/fragment@18:target:0";
	};

	__local_fixups__ {

		fragment@12 {

			__overlay__ {
				vdd-supply = <0x00>;
				vdd-io-supply = <0x00>;
			};
		};

		fragment@13 {

			__overlay__ {
				vdd-supply = <0x00>;
				vdd-io-supply = <0x00>;
			};
		};

		fragment@14 {

			__overlay__ {
				vdda-phy-supply = <0x00>;
				vdda-pll-supply = <0x00>;
			};
		};

		fragment@15 {

			__overlay__ {
				vcc-supply = <0x00>;
				vccq2-supply = <0x00>;
				qcom,vddp-ref-clk-supply = <0x00>;
			};
		};

		fragment@16 {

			__overlay__ {

				dwc3@4e00000 {
					usb-phy = <0x00>;
				};
			};
		};
	};
};
